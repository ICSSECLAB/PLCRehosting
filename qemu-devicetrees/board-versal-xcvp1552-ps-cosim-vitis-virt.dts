/* Auto-Generated via Makefile
 *
 * Copyright (c) 2022, AMD Inc
 * All rights reserved.
 *
 * SPDX-License-Identifier: BSD-3-Clause
 */
#include "board-versal-xcvp1552-ps-virt.dts"
#include "versal-ps-pl-remoteport.dtsi"
#include "versal-vitis.dtsi"
